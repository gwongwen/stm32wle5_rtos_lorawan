## CMakeLists.txt
```
cmake_minimum_required(VERSION 3.20.0)

find_package(Zephyr REQUIRED HINTS $ENV{ZEPHYR_BASE})
project(stm32wle5_rtos_lorawan)

FILE(GLOB app_sources src/*.c)
target_sources(app PRIVATE ${app_sources})
```

## prj.conf
```kconfig
# Debugger Support
CONFIG_CONSOLE=y
CONFIG_UART_CONSOLE=y

# Communication Bus Support
CONFIG_GPIO=y
CONFIG_SPI=y

# LoRa Support
CONFIG_LORA=y

# LoraWAN Support
CONFIG_LORAWAN=y
CONFIG_LORAMAC_REGION_EU868=y
CONFIG_LORAWAN_APP_CLOCK_SYNC=n
CONFIG_LORAWAN_SERVICES=n
CONFIG_LORAWAN_SYSTEM_MAX_RX_ERROR=200

# Flash Memory Support
CONFIG_NVS=y
CONFIG_FLASH=y
CONFIG_FLASH_PAGE_LAYOUT=y
CONFIG_MPU_ALLOW_FLASH_WRITE=y

# Stack Support
CONFIG_MAIN_STACK_SIZE=2048
CONFIG_SYSTEM_WORKQUEUE_STACK_SIZE=2048
```

## boards/stm32wl_dw1000_iot_board.overlay
```dts
/*
 * Copyright (c) 2023
 * Regis Rousseau
 * Univ Lyon, INSA Lyon, Inria, CITI, EA3720
 * SPDX-License-Identifier: Apache-2.0
 */

/* VBAT battery voltage monitoring */
/* external ADC channnel of STM32, IN5 - Port PB1 on schematic */
/* ratio = 2 -> voltage-divider by 2 on schematic */
/ {
	stm32_vbat: stm32vbat {
    	compatible = "st,stm32-vbat";
    	io-channels = <&adc1 5>;
   		ratio = <2>;
    	status = "okay";
	};
};

/* enable the corresponding ADC, with the correct vref value (in mV) */
&adc1 {
	vref-channel = <13>;
	vbat-channel = <5>;
	vref-mv = <3300>;
	status = "okay";
};
```

## src/main.c
```c
/*
 * Copyright (c) 2023
 * Regis Rousseau
 * Univ Lyon, INSA Lyon, Inria, CITI, EA3720
 * SPDX-License-Identifier: Apache-2.0
 */

#include "app_lorawan.h"
#include "app_flash.h"

//  ======== defines ============================================
#define 	DELAY 			K_MINUTES(5)
#define 	MAX_DATA_LEN	10
#define 	OTAA
//#define	ABP

//  ======== globals ============================================
char data_tx[MAX_DATA_LEN] = {'h', 'e', 'l', 'l', 'o', 'w', 'o', 'r', 'l', 'd'};

// downlink callback
static void dl_callback(uint8_t port, bool data_pending, int16_t rssi, int8_t snr, uint8_t len, const uint8_t *data)
{
	printk("downlink data received: ");
    for(int8_t i=0; i < len; i++) {
		printk("%02X ", data[i]);
	}
    printk("\n");
	printk("port: %d, pending: %d, RSSI: %ddB, SNR: %ddBm\n", port, data_pending, rssi, snr);
}

// ADR change callback
static void lorwan_datarate_changed(enum lorawan_datarate dr)
{
	uint8_t unused, max_size;

	lorawan_get_payload_sizes(&unused, &max_size);
	printk("new datarate: DR_%d, max payload: %d\n", dr, max_size);
}

static const struct gpio_dt_spec led_tx = GPIO_DT_SPEC_GET(LED_TX, gpios);
static const struct gpio_dt_spec led_rx = GPIO_DT_SPEC_GET(LED_RX, gpios);

//  ======== main ===============================================
int8_t main(void)
{
	const struct device *lora_dev;
	static struct nvs_fs fs;
	
	struct lorawan_join_config join_cfg;
	uint16_t dev_nonce = 0u;

#ifdef OTAA
	uint8_t dev_eui[] 	= LORAWAN_DEV_EUI;
	uint8_t join_eui[]	= LORAWAN_JOIN_EUI;
	uint8_t app_key[]	= LORAWAN_APP_KEY;
#endif

#ifdef ABP
    uint8_t dev_addr[] = LORAWAN_DEV_ADDR;
    uint8_t nwk_skey[] = LORAWAN_NWK_SKEY;
    uint8_t app_skey[] = LORAWAN_APP_SKEY;
    uint8_t app_eui[]  = LORAWAN_APP_EUI;
#endif

	uint32_t gps_time;
	time_t unix_time;
	struct tm timeinfo;
	char buf[32];

	int ret = 0;
	ssize_t err = 0;
	int8_t itr = 1;

	// setup tx led at GPIO PC0
	ret = gpio_pin_configure_dt(&led_tx, GPIO_OUTPUT_ACTIVE);
	if (ret < 0) {
		return 0;
	}

	// setup rx led at GPIO PC1
	ret = gpio_pin_configure_dt(&led_rx, GPIO_OUTPUT_ACTIVE);
	if (ret < 0) {
		return 0;
	}

	printk("Zephyr LoRaWAN Node Example. Board: %s\n", CONFIG_BOARD);

	// initialization and reading/writing the devnonce parameter
	app_flash_init(&fs);
	app_flash_init_param(&fs, NVS_DEVNONCE_ID, &dev_nonce);
	
	printk("starting Loarawan node\n");
	lora_dev = DEVICE_DT_GET(DT_ALIAS(lora0));
	if (!device_is_ready(lora_dev)) {
		printk("%s: device not ready\n", lora_dev->name);
		return 0;
	}

	printk("starting Lorawan stack\n");
	ret = lorawan_set_region(LORAWAN_REGION_EU868);
	ret = lorawan_start();
	if (ret < 0) {
		printk("lorawan_start failed. error: %d\n", ret);
		return 0;
	}

	// enable ADR
    lorawan_enable_adr(true);

	// enable callbacks
	struct lorawan_downlink_cb downlink_cb = {
		.port = LW_RECV_PORT_ANY,
		.cb = dl_callback
	};
	lorawan_register_downlink_callback(&downlink_cb);
	lorawan_register_dr_changed_callback(lorwan_datarate_changed);

#ifdef OTAA
	join_cfg.mode = LORAWAN_ACT_OTAA;
	join_cfg.dev_eui = dev_eui;
	join_cfg.otaa.join_eui = join_eui;
	join_cfg.otaa.app_key = app_key;
	join_cfg.otaa.nwk_key = app_key;
	join_cfg.otaa.dev_nonce = dev_nonce;
#endif

#ifdef ABP
    join_cfg.mode = LORAWAN_ACT_ABP;
    join_cfg.dev_eui = dev_addr;
    join_cfg.abp.dev_addr = dev_addr;
    join_cfg.abp.app_skey = app_skey;
    join_cfg.abp.nwk_skey = nwk_skey;
    join_cfg.abp.app_eui  = app_eui;
#endif


#ifdef OTAA
	do {
		printk("joining network using OTAA, dev nonce %d, attempt %d\n", join_cfg.otaa.dev_nonce, itr++);
		ret = lorawan_join(&join_cfg);

		// flashing of the LED when a packet is received
		ret = gpio_pin_toggle_dt(&led_rx);
			if (ret < 0) {
				return 0;
			}

		if (ret < 0) {
			if ((ret =-ETIMEDOUT)) {
				printk("timed-out waiting for response.\n");
			} else {
				printk("join network failed. error: %d\n", ret);
			}
		} else {
			printk("OTAA join successful\n");
		}

		dev_nonce++;
		join_cfg.otaa.dev_nonce = dev_nonce;

		// save value away in Non-Volatile Storage.
		err = nvs_write(&fs, NVS_DEVNONCE_ID, &dev_nonce, sizeof(dev_nonce));
		if (err < 0) {
			printk("NVS: failed to write id %d. error: %d\n", NVS_DEVNONCE_ID, err);
		}

		if (ret < 0) {
			// if failed, wait before re-trying.
			k_sleep(DELAY);
		}
	} while (ret != 0);	
#endif

#ifdef ABP
	do {
		ret = lorawan_join(&join_cfg);

		// flashing of the LED when a packet is received
		ret = gpio_pin_toggle_dt(&led_rx);
			if (ret < 0) {
				return 0;
			}

		if (ret < 0) {
			printk("join network failed. error: %d\n", ret);
			k_sleep(DELAY);
		} else {
			printk("ABP join successful\n");
		}
	} while (ret != 0)	;
#endif

#ifdef CONFIG_LORAWAN_APP_CLOCK_SYNC
	lorawan_clock_sync_run();
	ret = lorawan_clock_sync_get(&gps_time);
		if (ret != 0) { 
			printk("lorawan clock sync get failed. error: %d\n", ret);
		} else {
			/* 
			 * The difference in time between UNIX (epoch Jan 1st 1970) and
			 * GPS (epoch Jan 6th 1980) is 315964800 seconds. This is a bit
			 * of a fudge as it doesn't take into account leap seconds and 
			 * hence is out by roughly 18 seconds. 
			 *
			 */
			unix_time = gps_time - 315964800;
			localtime_r(&unix_time, &timeinfo);
			strftime(buf, sizeof(buf), "%A %B %d %Y %I:%M:%S %p %Z", &timeinfo);
			printk("GPS time (seconds since Jan 6th 1980) = %"PRIu32", UTC time: %s\n", gps_time, buf);
		}
#endif

	printk("sending data...\n");
	while (1) {
		// transmission of packets to lorawan gateway
		ret = lorawan_send(2, data_tx, sizeof(data_tx), LORAWAN_MSG_CONFIRMED);

		if (ret == -EAGAIN) {
			printk("lorawan_send failed: %d. continuing...\n", ret);
			k_sleep(DELAY);
			continue;
		} else if (ret < 0) {
			printk("lorawan_send failed. error: %d\n", ret);
			return 0;
		}
		
		// flashing of the LED when a packet is transmitted
		ret = gpio_pin_toggle_dt(&led_tx);
			if (ret < 0) {
				return 0;
			}
		printk("data sent !\n");
		k_sleep(DELAY);
	}
	return 0;
}
```

## src/app_flash.c
```c
/*
 * Copyright (c) 2023
 * Regis Rousseau
 * Univ Lyon, INSA Lyon, Inria, CITI, EA3720
 * SPDX-License-Identifier: Apache-2.0
 */
 
#include "app_flash.h"

//  ======== globals ============================================
int8_t ind;		// declaration of isr index

//  ======== app_flash_init =====================================
int8_t app_flash_init(struct nvs_fs *fs)
{
	struct flash_pages_info info;
	int8_t ret;
	ssize_t size;

	// configuration of storage partition in flash memory
	fs->flash_device = NVS_PARTITION_DEVICE;
	if (!device_is_ready(fs->flash_device)) {
		printk("flash device \"%s\" is not ready\n", fs->flash_device->name);
		return 0;
	} else {
		printk("- found device: \"%s\", getting nvs memory\n", fs->flash_device->name);
	}

	fs->offset = NVS_PARTITION_OFFSET;
	ret = flash_get_page_info_by_offs(fs->flash_device, fs->offset, &info);
	if (ret) {
		printk("unable to get page info. error: %d\n", ret);
		return 0;
	}
	
	fs->sector_size = info.size;
	if (!fs->sector_size || fs->sector_size % info.size) {
		printk("invalid sector size\n");
		return 0;
	}
	printk("sector size: %d\n", info.size);

	// mounting data storage partition in flash memory
	fs->sector_count = 4U;
	ret = nvs_mount(fs);
	if (ret) {
		printk("flash init failed. error: %d\n", ret);
		return 0;
	}

	// cleaning data storage partition
	(void)nvs_delete(fs, NVS_SENSOR_ID);
	size =  nvs_calc_free_space(fs);
	printk("flash memory partition size: %d\n", size);

	// initialisation of isr index
	ind = 0;	
	return 0;
}

//  ======== app_flash_init_param ===============================
int8_t app_flash_init_param(struct nvs_fs *fs, uint16_t id, void *data)
{
	int8_t ret;

	ret = nvs_read(fs, id, data, sizeof(data));
	if (ret > 0) {
		printk("ID: %d, address: %s\n", id, data);
	} else {
		printk("no address found, adding %s at id %d\n", data, id);
		(void)nvs_write(fs, id, data, sizeof(data));	
	}
	return 0;
}
```

## src/app_flash.h
```c
/*
 * Copyright (c) 2023
 * Regis Rousseau
 * Univ Lyon, INSA Lyon, Inria, CITI, EA3720
 * SPDX-License-Identifier: Apache-2.0
 */

#ifndef APP_FLASH_H
#define APP_FLASH_H

//  ======== includes ==============================================
#include <zephyr/kernel.h>
#include <zephyr/device.h>
#include <zephyr/fs/nvs.h>
#include <zephyr/drivers/flash.h>
#include <zephyr/storage/flash_map.h>

//  ======== defines ===============================================
#define NVS_PARTITION			storage_partition
#define NVS_PARTITION_DEVICE	FIXED_PARTITION_DEVICE(NVS_PARTITION)
#define NVS_PARTITION_OFFSET	FIXED_PARTITION_OFFSET(NVS_PARTITION)  
#define NVS_DEVNONCE_ID			0
#define NVS_SENSOR_ID			1
#define NVS_BAT_ID    			2                       

//  ======== prototypes ============================================
int8_t app_flash_init(struct nvs_fs *fs);
int8_t app_flash_init_param(struct nvs_fs *fs, uint16_t id, void *data);

#endif /* APP_FLASH_H */
```

## src/app_lorawan.h
```c
/*
 * Copyright (c) 2023
 * Regis Rousseau
 * Univ Lyon, INSA Lyon, Inria, CITI, EA3720
 * SPDX-License-Identifier: Apache-2.0
 */

#ifndef APP_LORAWAN__H
#define APP_LORAWAN__H

//  ======== includes =============================================
#include <zephyr/device.h>
#include <zephyr/kernel.h>
#include <zephyr/drivers/gpio.h>
#include <zephyr/random/rand32.h>
#include <zephyr/lorawan/lorawan.h>
#include <time.h>

//  ======== defines ==============================================
/* led control */
#define LED_TX                  DT_ALIAS(led0)      // declared in device tree 
#define LED_RX                  DT_ALIAS(led1)      // declared in device tree 

/* customize based on network configuration */
// OTAA
#define LORAWAN_DEV_EUI			{ 0x70, 0xB3, 0xD5, 0x7E, 0xD0, 0x06, 0x21, 0xA5 }
#define LORAWAN_JOIN_EUI		{ 0x00, 0x00, 0x00, 0x00, 0x00, 0x00, 0x00, 0x00 }
#define LORAWAN_APP_KEY			{ 0xC7, 0x32, 0x0F, 0x37, 0xFF, 0x62, 0xE0, 0xA8, 0x4E, 0x94, 0xC1, 0x9C, 0x27, 0x2B, 0xFA, 0x4C }

// ABP
#define LORAWAN_DEV_ADDR        { 0x26, 0x0B, 0x21, 0xC4 }
#define LORAWAN_NWK_SKEY        { 0x68, 0x72, 0x40, 0x44, 0x12, 0x0C, 0x11, 0x65, 0x2F, 0x50, 0x19, 0x9B, 0x50, 0x48, 0xCB, 0xC1 }
#define LORAWAN_APP_SKEY        { 0x32, 0x9D, 0xE3, 0xB7, 0xA8, 0x34, 0x95, 0x7E, 0x7C, 0x48, 0xB6, 0x38, 0x60, 0x85, 0x58, 0xEC }
#define LORAWAN_APP_EUI         { 0x70, 0xB3, 0xD5, 0x7E, 0xD0, 0x06, 0x30, 0xAB }

#endif /* APP_LORAWAN__H */
```

## src/app_nvs.c
```c
/*
 * Copyright (c) 2023
 * Regis Rousseau
 * Univ Lyon, INSA Lyon, Inria, CITI, EA3720
 * SPDX-License-Identifier: Apache-2.0
 */

#include "app_nvs.h"

//  ======== app_nvs_init ===============================================
int8_t app_nvs_init(struct nvs_fs *fs)
{
	struct flash_pages_info info;
	int8_t ret;

	fs->flash_device = NVS_PARTITION_DEVICE;
	if (!device_is_ready(fs->flash_device)) {
		printk("flash device %s is not ready\n", fs->flash_device->name);
		return 0;
	}

	fs->offset = NVS_PARTITION_OFFSET;
	ret = flash_get_page_info_by_offs(fs->flash_device, fs->offset, &info);
	if (ret) {
		printk("unable to get page info. error: %d\n", ret);
		return 0;
	}

	fs->sector_size = info.size;
	if (!fs->sector_size || fs->sector_size % info.size) {
		printk("invalid sector size\n");
		return -EINVAL;
	}

	fs->sector_count = 4U;
	ret = nvs_mount(fs);
	if (ret) {
		printk("flash init failed. error: %d\n", ret);
		return 0;
	}
}

//  ======== app_nvs_init_param =========================================
int8_t app_nvs_init_param(struct nvs_fs *fs, uint16_t id, void *data)
{
	int8_t ret;

	ret = nvs_read(fs, id, data, sizeof(data));
	if (ret > 0) {
		printk("ID: %d, address: %s\n", id, data);
	} else {
		printk("no address found, adding %s at id %d\n", data, id);
		(void)nvs_write(fs, id, data, sizeof(data));	
	}
	return 0;
}
```

## src/app_nvs.h
```c
/*
 * Copyright (c) 2023
 * Regis Rousseau
 * Univ Lyon, INSA Lyon, Inria, CITI, EA3720
 * SPDX-License-Identifier: Apache-2.0
 */

#ifndef APP_NVS__H
#define APP_NVS__H

//  ======== includes =============================================
#include <zephyr/device.h>
#include <zephyr/kernel.h>
#include <zephyr/drivers/flash.h>
#include <zephyr/fs/nvs.h>
#include <zephyr/storage/flash_map.h>

//  ======== defines ==============================================
#define NVS_PARTITION			    storage_partition
#define NVS_PARTITION_DEVICE	    FIXED_PARTITION_DEVICE(NVS_PARTITION)
#define NVS_PARTITION_OFFSET	    FIXED_PARTITION_OFFSET(NVS_PARTITION)
#define NVS_DEVNONCE_ID             0

//  ======== prototypes ===========================================
int8_t app_nvs_init(struct nvs_fs *fs);
int8_t app_nvs_init_param(struct nvs_fs *fs, uint16_t id, void *data);

#endif /* APP_NVS__H */
```

## src/app_vbat.c
```c
/*
 * Copyright (c) 2023
 * Regis Rousseau
 * Univ Lyon, INSA Lyon, Inria, CITI, EA3720
 * SPDX-License-Identifier: Apache-2.0
 */

#include "app_vbat.h"

//  ======== app_stm32_vbat_init ============================================
int8_t app_stm32_vbat_init(const struct device *dev)
{
    // getting internal vbat ADC device at GPIO PB14
    dev = DEVICE_DT_GET_ONE(st_stm32_vbat);

    if (dev == NULL) {
        printk("error: no stm32 vbat device found\n");
		return 0;
	}

    if (!device_is_ready(dev)) {
		printk("error: stm32 vbat is not ready\n");
		return 0;
	} else {
        printk("- found device \"%s\", getting vbat data\n", dev->name);
    }
    return 0;
}

//  ======== app_stm32_get_vbat =============================================
uint16_t app_stm32_get_vbat(const struct device *dev)
{
    struct sensor_value bat_int32;
    uint16_t bat_uint16;
    int8_t ret;

    // getting vbat ADC device
    dev = DEVICE_DT_GET_ONE(st_stm32_vbat);

    // fetching data
    ret = sensor_sample_fetch(dev);
    if (ret < 0) {        
	    printk("stm32 vbat sample is not up to date. error: %d\n", ret);
	    return 0;
    }

    // getting channel function
	ret = sensor_channel_get(dev, SENSOR_CHAN_VOLTAGE, &bat_int32);
    if (ret < 0) {
        printk("can't read sensor channels. error: %d\n", ret);
	    return 0;
    }

    // battery level received and converted from channel get
    // resolution 12bits: 0 to 4095 (uint16)
    bat_uint16 = (uint16_t)(sensor_value_to_milli(&bat_int32));
    return bat_uint16;

}
```

## src/app_vbat.h
```c
/*
 * Copyright (c) 2023
 * Regis Rousseau
 * Univ Lyon, INSA Lyon, Inria, CITI, EA3720
 * SPDX-License-Identifier: Apache-2.0
 */

#ifndef APP_VBAT_H
#define APP_VBAT_H

//  ======== includes ==============================================
#include <zephyr/kernel.h>
#include <zephyr/device.h>
#include <zephyr/drivers/adc.h>
#include <zephyr/drivers/sensor.h>

//  ======== prototypes ============================================
int8_t app_stm32_vbat_init(const struct device *dev);
uint16_t app_stm32_get_vbat(const struct device *dev);

#endif /* APP_VBAT_H */
```
